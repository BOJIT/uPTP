/*
 * Copyright (c) 2025 Thomas Boje
 * SPDX-License-Identifier: Apache-2.0
 */

#include <zephyr/dt-bindings/pinctrl/ch32v20x_30x-pinctrl.h>

&pinctrl {
	usart4_default: usart4_default {
		group1 {
			pinmux = <CH32V20X_V30X_PINMUX_DEFINE(PC, 10, USART4, 0)>;
			output-high;
			drive-push-pull;
			slew-rate = "max-speed-10mhz";
		};

		group2 {
			pinmux = <CH32V20X_V30X_PINMUX_DEFINE(PC, 11, USART4, 0)>;
			bias-pull-up;
		};
	};
};
