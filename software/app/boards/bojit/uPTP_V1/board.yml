## software/app/boards/bojit/uPTP_V1/board.yml
```yaml
board:
  name: uptp_v1
  full_name: bojit_uptp
  vendor: bojit
  socs:
    - name: ch32v307
```

## software/app/boards/st/nucleo_f767zi_custom/board.yml
```yaml
board:
  name: nucleo_f767zi_custom
  full_name: Nucleo F767ZI
  vendor: st
  socs:
    - name: stm32f767xx
```
