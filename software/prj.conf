## west.yml
```
manifest:
  version: 0.8

  projects:
    - name: zephyr
      revision: v4.2.0
      url: https://github.com/zephyrproject-rtos/zephyr
      import:
        file: west.yml
        path-prefix: deps
        name-allowlist:
          - cmsis

  self:
    path: app
```

## prj.conf
```kconfig
CONFIG_MAIN_STACK_SIZE=4096
CONFIG_GPIO=y
CONFIG_LOG=y

CONFIG_LOG_DEFAULT_LEVEL=3
```

## src/main.c
```c
/**
 * @file main.c
 * @author James Bennion-Pedley
 * @brief Main entry point for application
 * @date 01/06/2025
 *
 * @copyright Copyright (c) 2025
 *
 */

/*--------------------------------- Includes ---------------------------------*/

#include <zephyr/kernel.h>

/*---------------------------- Macros & Constants ----------------------------*/

/*----------------------------------- State ----------------------------------*/

// Settings
static const int32_t sleep_time_ms = 50; // Target 20 FPS

/*------------------------------ Private Functions ---------------------------*/

/*------------------------------- Public Functions ---------------------------*/

/*-------------------------------- Entry Point -------------------------------*/

int main(void)
{
    while (1)
    {
        k_msleep(sleep_time_ms);
    }
}
```
